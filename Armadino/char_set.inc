/* LED patterns for digit 0 to 9 */
const uint8_t ledNum[] PROGMEM = {
	B00111111,
	B00000110,
	B01011011,
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	B01111111,
	B01101111
};

/* Printable ASCII character set for the LED matrix, from ASCII 33 to 126
Each character is an 5 columns x 8 row bitmap. A byte is used to represent each
column. 4th and 5th columns are 'optional' such that subsequent columns will be
skipped over too when any of these columns contains all 0's. */
#define CHAR_WIDTH 5
const uint8_t  charSet[] PROGMEM = {
	B00000000,
	B01011111,
	B00000000,
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	B00000010,
	B00000000 	// Symbol ~ (ASCII 126)
};
